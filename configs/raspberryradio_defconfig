## configs/raspberryradio_defconfig
```kconfig
BR2_arm=y
BR2_arm1176jzf_s=y
BR2_KERNEL_MIRROR="http://www.kernel.org/pub"
BR2_LUAROCKS_MIRROR="http://luarocks.org/repositories/rocks"
BR2_CPAN_MIRROR="http://search.cpan.org/CPAN"
BR2_KERNEL_HEADERS_3_12=y
BR2_TOOLCHAIN_BUILDROOT_LARGEFILE=y
BR2_TOOLCHAIN_BUILDROOT_INET_RPC=y
BR2_TOOLCHAIN_BUILDROOT_WCHAR=y
BR2_GCC_VERSION_4_7_X=y
BR2_TOOLCHAIN_BUILDROOT_CXX=y
BR2_TARGET_GENERIC_HOSTNAME="raspberryradio"
BR2_TARGET_GENERIC_ISSUE="Welcome to RaspberryRadio"
BR2_ROOTFS_DEVICE_CREATION_DYNAMIC_MDEV=y
BR2_TARGET_GENERIC_ROOT_PASSWD="root"
BR2_TARGET_GENERIC_GETTY_PORT="tty1"
BR2_ROOTFS_OVERLAY="board/mojo2k/raspberryradio/overlay"
BR2_ROOTFS_POST_BUILD_SCRIPT="board/mojo2k/raspberryradio/postscript.sh"
BR2_LINUX_KERNEL=y
BR2_LINUX_KERNEL_CUSTOM_GIT=y
BR2_LINUX_KERNEL_CUSTOM_REPO_URL="git://github.com/raspberrypi/linux.git"
BR2_LINUX_KERNEL_CUSTOM_REPO_VERSION="rpi-3.12.y"
BR2_LINUX_KERNEL_USE_CUSTOM_CONFIG=y
BR2_LINUX_KERNEL_CUSTOM_CONFIG_FILE="board/mojo2k/raspberryradio/linux-3.12.y.def.config"
BR2_LINUX_KERNEL_ZIMAGE=y
BR2_PACKAGE_BUSYBOX_WATCHDOG=y
BR2_PACKAGE_ALSA_UTILS=y
BR2_PACKAGE_ALSA_UTILS_ALSACONF=y
BR2_PACKAGE_ALSA_UTILS_AMIXER=y
BR2_PACKAGE_ALSA_UTILS_APLAY=y
BR2_PACKAGE_ALSA_UTILS_SPEAKER_TEST=y
BR2_PACKAGE_MPD=y
BR2_PACKAGE_MPD_LIBSOXR=y
BR2_PACKAGE_MPD_MPG123=y
BR2_PACKAGE_MPD_LIBNFS=y
BR2_PACKAGE_MPD_UPNP=y
BR2_PACKAGE_CIFS_UTILS=y
BR2_PACKAGE_UNIONFS=y
BR2_PACKAGE_LINUX_FIRMWARE=y
BR2_PACKAGE_LINUX_FIRMWARE_RTL_87XX=y
BR2_PACKAGE_RPI_FIRMWARE=y
BR2_PACKAGE_LCDPROC=y
BR2_PACKAGE_RPI_USERLAND=y
BR2_PACKAGE_UBOOT_TOOLS=y
BR2_PACKAGE_UBOOT_TOOLS_MKIMAGE=y
BR2_PACKAGE_UBOOT_TOOLS_MKENVIMAGE=y
BR2_PACKAGE_PYTHON=y
BR2_PACKAGE_PYTHON_SQLITE=y
BR2_PACKAGE_PYTHON_RPIGPIO=y
BR2_PACKAGE_PYTHON_MPDLCD=y
BR2_PACKAGE_PYTHON_LCDPROC=y
BR2_PACKAGE_PYTHON_MPD2=y
BR2_PACKAGE_LIBCONFIG=y
BR2_PACKAGE_DTC=y
BR2_PACKAGE_LIBTIRPC=y
BR2_PACKAGE_BOOST_PYTHON=y
BR2_PACKAGE_DROPBEAR=y
BR2_PACKAGE_NTP=y
BR2_PACKAGE_PORTMAP=y
BR2_PACKAGE_WIRELESS_TOOLS=y
BR2_PACKAGE_WIRELESS_TOOLS_LIB=y
BR2_PACKAGE_WPA_SUPPLICANT=y
BR2_PACKAGE_WPA_SUPPLICANT_CLI=y
BR2_PACKAGE_WPA_SUPPLICANT_PASSPHRASE=y
BR2_PACKAGE_SUPERVISOR=y
BR2_PACKAGE_NANO=y
BR2_TARGET_ROOTFS_CPIO_GZIP=y
BR2_TARGET_ROOTFS_CPIO_UIMAGE=y
BR2_TARGET_ROOTFS_INITRAMFS=y
# BR2_TARGET_ROOTFS_TAR is not set
BR2_TARGET_UBOOT=y
BR2_TARGET_UBOOT_BOARDNAME="rpi_b"
BR2_TARGET_UBOOT_CUSTOM_VERSION=y
BR2_TARGET_UBOOT_CUSTOM_VERSION_VALUE="2014.10"
BR2_PACKAGE_HOST_E2FSPROGS=y
BR2_PACKAGE_HOST_GENEXT2FS=y
```

## defconfig
```kconfig
BR2_arm=y
BR2_arm1176jzf_s=y
BR2_KERNEL_MIRROR="http://www.kernel.org/pub"
BR2_TOOLCHAIN_BUILDROOT_LARGEFILE=y
BR2_TOOLCHAIN_BUILDROOT_INET_RPC=y
BR2_TOOLCHAIN_BUILDROOT_WCHAR=y
BR2_GCC_VERSION_4_7_X=y
BR2_TOOLCHAIN_BUILDROOT_CXX=y
BR2_TARGET_GENERIC_HOSTNAME="raspberryradio"
BR2_TARGET_GENERIC_ISSUE="Welcome to RaspberryRadio"
BR2_TARGET_GENERIC_ROOT_PASSWD="root"
BR2_TARGET_GENERIC_GETTY_PORT="tty1"
BR2_ROOTFS_OVERLAY="board/raspberryradio/overlay"
BR2_ROOTFS_POST_BUILD_SCRIPT="board/raspberryradio/postscript.sh"
BR2_LINUX_KERNEL=y
BR2_LINUX_KERNEL_CUSTOM_GIT=y
BR2_LINUX_KERNEL_CUSTOM_REPO_URL="git://github.com/raspberrypi/linux.git"
BR2_LINUX_KERNEL_CUSTOM_REPO_VERSION="rpi-3.15.y"
BR2_LINUX_KERNEL_USE_CUSTOM_CONFIG=y
BR2_LINUX_KERNEL_CUSTOM_CONFIG_FILE="board/raspberryradio/linux-3.12.y.config"
BR2_LINUX_KERNEL_ZIMAGE=y
BR2_PACKAGE_BUSYBOX_WATCHDOG=y
BR2_PACKAGE_ALSA_UTILS=y
BR2_PACKAGE_ALSA_UTILS_ALSACONF=y
BR2_PACKAGE_ALSA_UTILS_AMIXER=y
BR2_PACKAGE_ALSA_UTILS_APLAY=y
BR2_PACKAGE_ALSA_UTILS_SPEAKER_TEST=y
BR2_PACKAGE_MPD=y
BR2_PACKAGE_MPD_MPG123=y
BR2_PACKAGE_CIFS_UTILS=y
BR2_PACKAGE_LINUX_FIRMWARE=y
BR2_PACKAGE_LINUX_FIRMWARE_RTL_87XX=y
BR2_PACKAGE_RPI_FIRMWARE=y
BR2_PACKAGE_LCDPROC=y
BR2_PACKAGE_RPI_USERLAND=y
BR2_PACKAGE_PYTHON=y
BR2_PACKAGE_PYTHON_SQLITE=y
BR2_PACKAGE_PYTHON_RPIGPIO=y
BR2_PACKAGE_LIBFUSE=y
BR2_PACKAGE_LIBTIRPC=y
BR2_PACKAGE_DROPBEAR=y
BR2_PACKAGE_PORTMAP=y
BR2_PACKAGE_WIRELESS_TOOLS=y
BR2_PACKAGE_WIRELESS_TOOLS_LIB=y
BR2_PACKAGE_WPA_SUPPLICANT=y
BR2_PACKAGE_WPA_SUPPLICANT_CLI=y
BR2_PACKAGE_WPA_SUPPLICANT_PASSPHRASE=y
BR2_PACKAGE_SUPERVISOR=y
BR2_PACKAGE_NANO=y
BR2_TARGET_ROOTFS_INITRAMFS=y
# BR2_TARGET_ROOTFS_TAR is not set
BR2_PACKAGE_HOST_E2FSPROGS=y
BR2_PACKAGE_HOST_GENEXT2FS=y
```

## package/aufs-modules/Config.in
```kconfig
config BR2_PACKAGE_AUFS_MODULES
	bool "aufs-modules"
	depends on BR2_LINUX_KERNEL
	help
          Aufs

comment "aufs-modules needs a Linux kernel to be built"
	depends on BR2_LINUX_KERNEL
```

## package/python-lcdproc/Config.in
```kconfig
config BR2_PACKAGE_PYTHON_LCDPROC
	bool "python-lcdproc"
	depends on BR2_PACKAGE_PYTHON 
	help
	  Python OOP Wrapper Library for LCDproc Telnet API

          https://pypi.python.org/pypi/lcdproc/0.03
```

## package/python-mpd2/Config.in
```kconfig
config BR2_PACKAGE_PYTHON_MPD2
	bool "python-mpd2"
	depends on BR2_PACKAGE_PYTHON 
        select BR2_PACKAGE_PYTHON_SETUPTOOLS
	help
	  A Python MPD client library.

          https://pypi.python.org/pypi/python-mpd2
```

## package/python-mpdlcd/Config.in
```kconfig
config BR2_PACKAGE_PYTHON_MPDLCD
	bool "python-mpdlcd"
	depends on BR2_PACKAGE_PYTHON 
        select BR2_PACKAGE_PYTHON_SETUPTOOLS
	help
	  Display MPD status on a lcdproc server.

          https://pypi.python.org/pypi/mpdlcd/0.4.0
```

## package/python-mradio/Config.in
```kconfig
config BR2_PACKAGE_PYTHON_MRADIO
	bool "python-mradio"
	depends on BR2_PACKAGE_PYTHON 
        select BR2_PACKAGE_PYTHON_SETUPTOOLS
	help
	  A webradio script, based on mpdlcd.
```

## package/python-rpigpio/Config.in
```kconfig
config BR2_PACKAGE_PYTHON_RPIGPIO
	bool "python-rpigpio"
	depends on BR2_PACKAGE_PYTHON
	help
	  python-rpigpio is a Python library to access raspberry hardware layer.

          http://www.google.de
```

## package/uboot-tools/Config.in
```kconfig
config BR2_PACKAGE_UBOOT_TOOLS
	bool "u-boot tools"
	help
	  Companion tools for Das U-Boot bootloader.

	  http://www.denx.de/wiki/U-Boot/WebHome

if BR2_PACKAGE_UBOOT_TOOLS
config BR2_PACKAGE_UBOOT_TOOLS_BOARDNAME
        string "U-Boot board name"
        help
          One of U-Boot supported boards to be built.
          This will be suffixed with _config to meet U-Boot standard naming.
          See boards.cfg in U-Boot source code for the list of available
          configurations.

config BR2_PACKAGE_UBOOT_TOOLS_MKIMAGE
	bool "mkimage"
	help
	  The mkimage tool from Das U-Boot bootloader, which allows
	  generation of U-Boot images in various formats.

config BR2_PACKAGE_UBOOT_TOOLS_MKENVIMAGE
	bool "mkenvimage"
	help
	  The mkenvimage tool from Das U-Boot bootloader, which allows
	  generation of a valid binary environment image from a text file
	  describing the key=value pairs of the environment.

config BR2_PACKAGE_UBOOT_TOOLS_FWPRINTENV
	bool "fw_printenv"
	default y
	help
	  The fw_printenv / fw_setenv tools from Das U-Boot
	  bootloader, which allows access to the U-Boot environment
	  from Linux.

endif
```
